/* charly-test_l.overlay */
#include "charly-test.dtsi"

&kscan0 {
    compatible = "zmk,kscan-gpio-charlieplex";

    /* D1 = P0.03 */
    interrupt-gpios = <&gpio0 3 (GPIO_ACTIVE_HIGH | GPIO_PULL_DOWN)>;

    gpios = 
    <&gpio1 15 GPIO_ACTIVE_HIGH>,  // D10
    <&gpio1 14 GPIO_ACTIVE_HIGH>,  // D9
    <&gpio1 13 GPIO_ACTIVE_HIGH>,  // D8
    <&gpio1 12 GPIO_ACTIVE_HIGH>,  // D7
    <&gpio1 11 GPIO_ACTIVE_HIGH>,  // D6
    <&gpio0 29 GPIO_ACTIVE_HIGH>,  // D3
    <&gpio0 28 GPIO_ACTIVE_HIGH>,  // D2
    <&gpio0  2 GPIO_ACTIVE_HIGH>;  // D0
};

&left1_encoder {
   status = "okay";
};

&left2_encoder {
   status = "okay";
};