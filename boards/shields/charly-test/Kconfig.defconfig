## boards/shields/charly-test/Kconfig.defconfig
```kconfig
if SHIELD_CHARLYTEST_L

config ZMK_KEYBOARD_NAME
    default "charly-test"

config ZMK_SPLIT_ROLE_CENTRAL
    default y

endif

if SHIELD_CHARLYTEST_R|| SHIELD_CHARLYTEST_L

config ZMK_SPLIT
    default y


endif

if SHIELD_CHARLYTEST_L

# Other settings

config ZMK_POINTING
    default y

# Assuming pointing device uses SPI
config SPI
    default y

endif
```

## boards/shields/charly-test/Kconfig.shield
```kconfig
config SHIELD_CHARLYTEST_R
    def_bool $(shields_list_contains,charly-test_r)

config SHIELD_CHARLYTEST_L
    def_bool $(shields_list_contains,charly-test_l)
```
